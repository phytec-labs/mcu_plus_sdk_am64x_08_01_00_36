/**
 * @cliArgs --device "AM64x_beta" --package "ALV" --part "Default" --context "r5fss0-0" --product "MCU_PLUS_SDK_AM64x@08.01.00"
 * @versions {"tool":"1.9.0+2015","templates":null}
 */

/**
 * Import the modules used in this configuration.
 */
const eeprom     = scripting.addModule("/board/eeprom/eeprom", {}, false);
const eeprom1    = eeprom.addInstance();
const flash      = scripting.addModule("/board/flash/flash", {}, false);
const flash1     = flash.addInstance();
const led        = scripting.addModule("/board/led/led", {}, false);
const led1       = led.addInstance();
const led2       = led.addInstance();
const gpio       = scripting.addModule("/drivers/gpio/gpio", {}, false);
const gpio1      = gpio.addInstance();
const i2c        = scripting.addModule("/drivers/i2c/i2c", {}, false);
const i2c1       = i2c.addInstance();
const i2c2       = i2c.addInstance();
const pruicss    = scripting.addModule("/drivers/pruicss/pruicss", {}, false);
const pruicss1   = pruicss.addInstance();
const uart       = scripting.addModule("/drivers/uart/uart", {}, false);
const uart1      = uart.addInstance();
const profinet   = scripting.addModule("/industrial_comms/profinet/profinet", {}, false);
const profinet1  = profinet.addInstance();
const debug_log  = scripting.addModule("/kernel/dpl/debug_log");
const mpu_armv7  = scripting.addModule("/kernel/dpl/mpu_armv7", {}, false);
const mpu_armv71 = mpu_armv7.addInstance();
const mpu_armv72 = mpu_armv7.addInstance();
const mpu_armv73 = mpu_armv7.addInstance();
const mpu_armv74 = mpu_armv7.addInstance();
const mpu_armv75 = mpu_armv7.addInstance();
const timer      = scripting.addModule("/kernel/dpl/timer", {}, false);
const timer1     = timer.addInstance();

/**
 * Write custom configuration values to the imported modules.
 */
eeprom1.$name = "CONFIG_EEPROM0";

flash1.$name                         = "CONFIG_FLASH0";
flash1.peripheralDriver.$name        = "CONFIG_OSPI0";
flash1.peripheralDriver.inputClkFreq = 166666666;
flash1.peripheralDriver.phyEnable    = true;
flash1.peripheralDriver.OSPI.$assign = "OSPI0";

led1.$name = "CONFIG_CYCLIC_LEDS";
led1.name  = "TPIC2810";

led2.$name = "CONFIG_BUS_LED";

led2.peripheralDriver          = gpio1;
gpio1.pinDir                   = "OUTPUT";
gpio1.useMcuDomainPeripherals  = true;
gpio1.$name                    = "CONFIG_GPIO_BUS_LED";
gpio1.MCU_GPIO.$assign         = "MCU_GPIO0";
gpio1.MCU_GPIO.gpioPin.$assign = "ball.A7";

led1.peripheralDriver = i2c1;
i2c1.$name            = "CONFIG_I2C_CYCLIC_LEDS";
i2c1.I2C.$assign      = "I2C1";

i2c2.$name               = "CONFIG_I2C_EEPROM";
eeprom1.peripheralDriver = i2c2;
i2c2.I2C.$assign         = "I2C0";

uart1.$name                   = "CONFIG_UART1";
uart1.intrEnable              = "USER_INTR";
uart1.rxTrigLvl               = "1";
uart1.useMcuDomainPeripherals = true;
uart1.MCU_UART.$assign        = "MCU_USART0";

profinet1.$name                       = "CONFIG_PROFINET0";
profinet1.phyToMacInterfaceMode       = "RGMII";
profinet1.rtMode                      = "IRT";
profinet1.icss_emac[0].$name          = "CONFIG_ICSS_EMAC0";
profinet1.icss_emac[0].instance       = scripting.forceWrite("ICSSG1");
profinet1.icss_emac[0].mode           = scripting.forceWrite("SWITCH");
profinet1.icss_emac[0].phyAddr0       = scripting.forceWrite(15);
profinet1.icss_emac[0].learningEnable = true;
profinet1.ethphy1[0].$name            = "CONFIG_ETHPHY0";
profinet1.ethphy2[0].$name            = "CONFIG_ETHPHY1";
profinet1.PRU_ICSSG1_RGMII1.$assign   = "PRU_ICSSG1_RGMII1";

profinet1.icss = pruicss1;
pruicss1.$name = "CONFIG_PRU_ICSS1";

debug_log.enableUartLog        = true;
debug_log.uartLog.$name        = "CONFIG_UART_CONSOLE";
debug_log.uartLog.UART.$assign = "USART0";

mpu_armv71.$name             = "CONFIG_MPU_REGION0";
mpu_armv71.size              = 31;
mpu_armv71.accessPermissions = "Supervisor RD+WR, User RD";
mpu_armv71.attributes        = "Device";
mpu_armv71.allowExecute      = false;

mpu_armv72.$name             = "CONFIG_MPU_REGION1";
mpu_armv72.size              = 15;
mpu_armv72.accessPermissions = "Supervisor RD+WR, User RD";

mpu_armv73.$name             = "CONFIG_MPU_REGION2";
mpu_armv73.baseAddr          = 0x41010000;
mpu_armv73.size              = 15;
mpu_armv73.accessPermissions = "Supervisor RD+WR, User RD";

mpu_armv74.$name             = "CONFIG_MPU_REGION3";
mpu_armv74.baseAddr          = 0x70000000;
mpu_armv74.size              = 21;
mpu_armv74.accessPermissions = "Supervisor RD+WR, User RD";

mpu_armv75.$name        = "CONFIG_MPU_REGION6";
mpu_armv75.allowExecute = false;
mpu_armv75.baseAddr     = 0x70000000;
mpu_armv75.size         = 16;
mpu_armv75.attributes   = "Cached+Sharable";

timer1.$name         = "CONFIG_TIMER0";
timer1.startTimer    = true;
timer1.timerCallback = "OSAL_FREERTOS_callbackTimer";
timer1.TIMER.$assign = "DMTIMER0";

/**
 * Pinmux solution for unlocked pins/peripherals. This ensures that minor changes to the automatic solver in a future
 * version of the tool will not impact the pinmux you originally saw.  These lines can be completely deleted in order to
 * re-solve from scratch.
 */
flash1.peripheralDriver.OSPI.CLK.$suggestSolution       = "ball.N20";
flash1.peripheralDriver.OSPI.CSn0.$suggestSolution      = "ball.L19";
flash1.peripheralDriver.OSPI.DQS.$suggestSolution       = "ball.N19";
flash1.peripheralDriver.OSPI.D7.$suggestSolution        = "ball.M17";
flash1.peripheralDriver.OSPI.D6.$suggestSolution        = "ball.N18";
flash1.peripheralDriver.OSPI.D5.$suggestSolution        = "ball.P20";
flash1.peripheralDriver.OSPI.D4.$suggestSolution        = "ball.P21";
flash1.peripheralDriver.OSPI.D3.$suggestSolution        = "ball.M21";
flash1.peripheralDriver.OSPI.D2.$suggestSolution        = "ball.M20";
flash1.peripheralDriver.OSPI.D1.$suggestSolution        = "ball.M18";
flash1.peripheralDriver.OSPI.D0.$suggestSolution        = "ball.M19";
i2c1.I2C.SCL.$suggestSolution                           = "ball.C18";
i2c1.I2C.SDA.$suggestSolution                           = "ball.B19";
i2c2.I2C.SCL.$suggestSolution                           = "ball.A18";
i2c2.I2C.SDA.$suggestSolution                           = "ball.B18";
uart1.MCU_UART.RXD.$suggestSolution                     = "ball.A9";
uart1.MCU_UART.TXD.$suggestSolution                     = "ball.A8";
profinet1.PRU_ICSSG1_MDIO.$suggestSolution              = "PRU_ICSSG1_MDIO0";
profinet1.PRU_ICSSG1_MDIO.MDC.$suggestSolution          = "ball.Y6";
profinet1.PRU_ICSSG1_MDIO.MDIO.$suggestSolution         = "ball.AA6";
profinet1.PRU_ICSSG1_RGMII1.RD0.$suggestSolution        = "ball.Y7";
profinet1.PRU_ICSSG1_RGMII1.RD1.$suggestSolution        = "ball.U8";
profinet1.PRU_ICSSG1_RGMII1.RD2.$suggestSolution        = "ball.W8";
profinet1.PRU_ICSSG1_RGMII1.RD3.$suggestSolution        = "ball.V8";
profinet1.PRU_ICSSG1_RGMII1.RXC.$suggestSolution        = "ball.AA7";
profinet1.PRU_ICSSG1_RGMII1.RX_CTL.$suggestSolution     = "ball.Y8";
profinet1.PRU_ICSSG1_RGMII1.TD0.$suggestSolution        = "ball.AA8";
profinet1.PRU_ICSSG1_RGMII1.TD1.$suggestSolution        = "ball.U9";
profinet1.PRU_ICSSG1_RGMII1.TD2.$suggestSolution        = "ball.W9";
profinet1.PRU_ICSSG1_RGMII1.TD3.$suggestSolution        = "ball.AA9";
profinet1.PRU_ICSSG1_RGMII1.TXC.$suggestSolution        = "ball.V9";
profinet1.PRU_ICSSG1_RGMII1.TX_CTL.$suggestSolution     = "ball.Y9";
profinet1.PRU_ICSSG1_RGMII2.$suggestSolution            = "PRU_ICSSG1_RGMII2";
profinet1.PRU_ICSSG1_RGMII2.RD0.$suggestSolution        = "ball.W11";
profinet1.PRU_ICSSG1_RGMII2.RD1.$suggestSolution        = "ball.V11";
profinet1.PRU_ICSSG1_RGMII2.RD2.$suggestSolution        = "ball.AA12";
profinet1.PRU_ICSSG1_RGMII2.RD3.$suggestSolution        = "ball.Y12";
profinet1.PRU_ICSSG1_RGMII2.RXC.$suggestSolution        = "ball.U11";
profinet1.PRU_ICSSG1_RGMII2.RX_CTL.$suggestSolution     = "ball.W12";
profinet1.PRU_ICSSG1_RGMII2.TD0.$suggestSolution        = "ball.AA10";
profinet1.PRU_ICSSG1_RGMII2.TD1.$suggestSolution        = "ball.V10";
profinet1.PRU_ICSSG1_RGMII2.TD2.$suggestSolution        = "ball.U10";
profinet1.PRU_ICSSG1_RGMII2.TD3.$suggestSolution        = "ball.AA11";
profinet1.PRU_ICSSG1_RGMII2.TXC.$suggestSolution        = "ball.Y10";
profinet1.PRU_ICSSG1_RGMII2.TX_CTL.$suggestSolution     = "ball.Y11";
profinet1.PRU_ICSSG1_IEP.$suggestSolution               = "PRU_ICSSG1_IEP0";
profinet1.PRU_ICSSG1_IEP.EDC_LATCH_IN0.$suggestSolution = "ball.V7";
profinet1.PRU_ICSSG1_IEP.EDC_LATCH_IN1.$suggestSolution = "ball.U13";
profinet1.PRU_ICSSG1_IEP.EDC_SYNC_OUT0.$suggestSolution = "ball.W7";
profinet1.PRU_ICSSG1_IEP.EDC_SYNC_OUT1.$suggestSolution = "ball.U7";
debug_log.uartLog.UART.RXD.$suggestSolution             = "ball.D15";
debug_log.uartLog.UART.TXD.$suggestSolution             = "ball.C16";
