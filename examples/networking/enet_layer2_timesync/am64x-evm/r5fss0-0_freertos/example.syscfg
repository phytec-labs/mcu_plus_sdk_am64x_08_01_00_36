/**
 * @cliArgs --device "AM64x_beta" --package "ALV" --part "Default" --context "r5fss0-0" --product "MCU_PLUS_SDK@07.03.01"
 * @versions {"data":"2021040816","timestamp":"2021040816","tool":"1.8.1+1900","templates":null}
 */

/**
 * Import the modules used in this configuration.
 */
const gpio       = scripting.addModule("/drivers/gpio/gpio", {}, false);
const gpio1      = gpio.addInstance();
const i2c        = scripting.addModule("/drivers/i2c/i2c", {}, false);
const i2c1       = i2c.addInstance();
const i2c2       = i2c.addInstance();
const pruicss    = scripting.addModule("/drivers/pruicss/pruicss", {}, false);
const pruicss1   = pruicss.addInstance();
const debug_log  = scripting.addModule("/kernel/dpl/debug_log");
const mpu_armv7  = scripting.addModule("/kernel/dpl/mpu_armv7", {}, false);
const mpu_armv71 = mpu_armv7.addInstance();
const mpu_armv72 = mpu_armv7.addInstance();
const mpu_armv73 = mpu_armv7.addInstance();
const mpu_armv74 = mpu_armv7.addInstance();
const mpu_armv75 = mpu_armv7.addInstance();
const mpu_armv76 = mpu_armv7.addInstance();
const mpu_armv77 = mpu_armv7.addInstance();
const enet_cpsw  = scripting.addModule("/networking/enet_cpsw/enet_cpsw", {}, false);
const enet_cpsw1 = enet_cpsw.addInstance();

/**
 * Write custom configuration values to the imported modules.
 */
gpio1.$name                    = "CONFIG_GPIO0";
gpio1.pinDir                   = "OUTPUT";
gpio1.useMcuDomainPeripherals  = true;
gpio1.MCU_GPIO.$assign         = "MCU_GPIO0";
gpio1.MCU_GPIO.gpioPin.$assign = "A7";

i2c1.$name           = "CONFIG_I2C0";
i2c1.I2C.$assign     = "I2C0";
i2c1.I2C.SCL.$assign = "A18";
i2c1.I2C.SDA.$assign = "B18";

i2c2.$name           = "CONFIG_I2C1";
i2c2.I2C.$assign     = "I2C1";
i2c2.I2C.SCL.$assign = "C18";
i2c2.I2C.SDA.$assign = "B19";

pruicss1.$name    = "CONFIG_PRU_ICSS1";
pruicss1.instance = "ICSSG1";

debug_log.enableUartLog = true;
debug_log.enableCssLog  = false;
debug_log.uartLog.$name = "CONFIG_UART0";

mpu_armv71.$name             = "CONFIG_MPU_REGION0";
mpu_armv71.size              = 31;
mpu_armv71.attributes        = "Device";
mpu_armv71.accessPermissions = "Supervisor RD+WR, User RD";
mpu_armv71.allowExecute      = false;

mpu_armv72.$name             = "CONFIG_MPU_REGION1";
mpu_armv72.size              = 15;
mpu_armv72.accessPermissions = "Supervisor RD+WR, User RD";

mpu_armv73.$name             = "CONFIG_MPU_REGION2";
mpu_armv73.baseAddr          = 0x41010000;
mpu_armv73.size              = 15;
mpu_armv73.accessPermissions = "Supervisor RD+WR, User RD";

mpu_armv74.$name             = "CONFIG_MPU_REGION3";
mpu_armv74.accessPermissions = "Supervisor RD+WR, User RD";
mpu_armv74.baseAddr          = 0x70000000;
mpu_armv74.size              = 23;

mpu_armv75.$name             = "CONFIG_MPU_REGION4";
mpu_armv75.accessPermissions = "Supervisor RD+WR, User RD";
mpu_armv75.baseAddr          = 0x80000000;
mpu_armv75.size              = 31;

mpu_armv76.$name             = "CONFIG_MPU_REGION5";
mpu_armv76.accessPermissions = "Supervisor RD+WR, User RD";
mpu_armv76.baseAddr          = 0xA5000000;
mpu_armv76.size              = 23;
mpu_armv76.attributes        = "NonCached";

mpu_armv77.$name    = "CONFIG_MPU_REGION6";
mpu_armv77.size     = 27;
mpu_armv77.baseAddr = 0x60000000;

enet_cpsw1.$name                 = "CONFIG_ENET_CPSW0";
enet_cpsw1.phyAddr1               = 0;
enet_cpsw1.phyAddr2               = 0;
enet_cpsw1.phyToMacInterfaceMode = "RGMII";

/**
 * Pinmux solution for unlocked pins/peripherals. This ensures that minor changes to the automatic solver in a future
 * version of the tool will not impact the pinmux you originally saw.  These lines can be completely deleted in order to
 * re-solve from scratch.
 */
debug_log.uartLog.UART.$suggestSolution     = "USART0";
debug_log.uartLog.UART.RXD.$suggestSolution = "D15";
debug_log.uartLog.UART.TXD.$suggestSolution = "C16";
enet_cpsw1.MDIO.$suggestSolution            = "MDIO0";
enet_cpsw1.MDIO.MDC.$suggestSolution        = "R2";
enet_cpsw1.MDIO.MDIO.$suggestSolution       = "P5";
enet_cpsw1.RGMII.$suggestSolution           = "RGMII1";
enet_cpsw1.RGMII.RD0.$suggestSolution       = "W5";
enet_cpsw1.RGMII.RD1.$suggestSolution       = "Y5";
enet_cpsw1.RGMII.RD2.$suggestSolution       = "V6";
enet_cpsw1.RGMII.RD3.$suggestSolution       = "V5";
enet_cpsw1.RGMII.RX_CTL.$suggestSolution    = "W6";
enet_cpsw1.RGMII.RXC.$suggestSolution       = "AA5";
enet_cpsw1.RGMII.TD0.$suggestSolution       = "V15";
enet_cpsw1.RGMII.TD1.$suggestSolution       = "V14";
enet_cpsw1.RGMII.TD2.$suggestSolution       = "W14";
enet_cpsw1.RGMII.TD3.$suggestSolution       = "AA14";
enet_cpsw1.RGMII.TX_CTL.$suggestSolution    = "U15";
enet_cpsw1.RGMII.TXC.$suggestSolution       = "U14";
